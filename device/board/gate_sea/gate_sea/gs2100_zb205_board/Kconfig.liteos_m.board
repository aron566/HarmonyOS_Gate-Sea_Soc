## device/board/gate_sea/gate_sea/gs2100_zb205_board/Kconfig.liteos_m.board
```kconfig
# Copyright (C) 2024 Gate-Sea Open Source Organization .
# Licensed under the Apache License, Version 2.0 (the "License");
# you may not use this file except in compliance with the License.
# You may obtain a copy of the License at
#
# http://www.apache.org/licenses/LICENSE-2.0
#
# Unless required by applicable law or agreed to in writing, software
# distributed under the License is distributed on an "AS IS" BASIS,
# WITHOUT WARRANTIES OR CONDITIONS OF ANY KIND, either express or implied.
# See the License for the specific language governing permissions and
# limitations under the License.

menuconfig BOARD_GS2100_ZB205_BOARD
    bool "select board gs2100_zb205_board"
    depends on SOC_GS2100XX

orsource "liteos_m/hdf_config/Kconfig.liteos_m.board"
orsource "applications/Kconfig.board.applications"
```

## device/soc/gate_sea/gate_sea/gs2000xx/Kconfig.liteos_m.series
```kconfig
# Copyright (c) 2024-2026 Gate-Sea Co., Ltd.
# Licensed under the Apache License, Version 2.0 (the "License");
# you may not use this file except in compliance with the License.
# You may obtain a copy of the License at
#
#     http://www.apache.org/licenses/LICENSE-2.0
#
# Unless required by applicable law or agreed to in writing, software
# distributed under the License is distributed on an "AS IS" BASIS,
# WITHOUT WARRANTIES OR CONDITIONS OF ANY KIND, either express or implied.
# See the License for the specific language governing permissions and
# limitations under the License.

config SOC_SERIES_GS2000xx
    bool "Gate-Sea GS2000xx series"
    select ARCH_ARM
    select SOC_COMPANY_GATE_SEA
    select CPU_CORTEX_M3
    help
        Enable support for Gate-Sea GS2000xx series
```
